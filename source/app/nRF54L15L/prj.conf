## CMakeLists.txt
```
# SPDX-License-Identifier: Apache-2.0

cmake_minimum_required(VERSION 3.20.0)
find_package(Zephyr REQUIRED HINTS $ENV{ZEPHYR_BASE})
project(blinky)

target_sources(app PRIVATE 
    src/main.cpp
    src/Serial.cpp
    )
```

## prj.conf
```kconfig
CONFIG_CPP=y
CONFIG_REQUIRES_FULL_LIBCPP=y
CONFIG_STD_CPP23=y

CONFIG_GPIO=y
CONFIG_SERIAL=y
CONFIG_UART_ASYNC_API=y
```

## boards/nrf54l15dk_nrf54l10_cpuapp_ns.overlay
```dts
// To get started, press Ctrl+Space to bring up the completion menu and view the available nodes.

// You can also use the buttons in the sidebar to perform actions on nodes.
// Actions currently available include:

// * Enabling / disabling the node
// * Adding the bus to a bus
// * Removing the node
// * Connecting ADC channels

// For more help, browse the DeviceTree documentation at https://docs.zephyrproject.org/latest/guides/dts/index.html
// You can also visit the nRF DeviceTree extension documentation at https://docs.nordicsemi.com/bundle/nrf-connect-vscode/page/guides/ncs_configure_app.html#devicetree-support-in-the-extension
&uart20 {
	current-speed = <460800>;
};
```

## src/main.cpp
```c
/*
 * Copyright (c) 2016 Intel Corporation
 *
 * SPDX-License-Identifier: Apache-2.0
 */

#include "Led.hpp"
#include "Button.hpp"
#include "Serial.hpp"

#include <zephyr/logging/log.h>
#include <zephyr/drivers/gpio.h>
#include <zephyr/kernel.h>

#define SLEEP_TIME_MS  	(100)

// Device tree nodes
static const struct gpio_dt_spec s_gpioLed 		= GPIO_DT_SPEC_GET(DT_ALIAS(led0), gpios);
static const struct gpio_dt_spec s_gpioButton 	= GPIO_DT_SPEC_GET(DT_ALIAS(sw0), gpios);
static const struct device *s_uart 				= DEVICE_DT_GET(DT_NODELABEL(uart20));	

// UART configuration
const struct uart_config uart_cfg = 
{
	.baudrate = 115200,	// Todo: This doesn't work; the one in the overlay does. Why?
	.parity = UART_CFG_PARITY_NONE,
	.stop_bits = UART_CFG_STOP_BITS_1,
	.data_bits = UART_CFG_DATA_BITS_8,
	.flow_ctrl = UART_CFG_FLOW_CTRL_NONE
};

static void uartCallback(const struct device *dev, struct uart_event *evt, void *user_data);

static uint8_t s_rxBuffer[10] = {0};
static std::span<uint8_t> s_rxBufferSpan(s_rxBuffer, sizeof(s_rxBuffer));
static Serial s_serial(uart_cfg, *s_uart, s_rxBufferSpan, uartCallback);

int main(void)
{
	Led led1(s_gpioLed);
	Button btn1(s_gpioButton);

	s_serial.Initialize();
	s_serial.Send("Hello!\n\r");

	bool btn1State = btn1.IsPressed();

	for(;;)
	{	
		auto state = btn1.IsPressed();
		if(state) 
		{
			led1.TurnOn();
		} 
		else 
		{
			led1.TurnOff();
		}

		if(btn1State != state) 
		{
			btn1State = state;
			printk("Button changed! LED is %s.\n", state ? "ON" : "OFF");
		}
	
		k_msleep(SLEEP_TIME_MS);
	}
	return 0;
}

static void uartCallback(const struct device *dev, struct uart_event *evt, void *user_data)
{
	switch (evt->type) 
	{	
	case UART_RX_RDY:
		printk("\n");
		for (size_t i = evt->data.rx.offset; i < evt->data.rx.offset + evt->data.rx.len; ++i) 
		{
			printk("%c", evt->data.rx.buf[i]);
		}
    	printk(" (echo)\n");
		break;

	case UART_RX_DISABLED:
		s_serial.EnableRx();
		break;

	// Intentional fallthrough
	case UART_TX_DONE:
	case UART_TX_ABORTED:
	case UART_RX_BUF_REQUEST:
	case UART_RX_BUF_RELEASED:
	case UART_RX_STOPPED:
	default:
		break;
	}
}
```

## src/Button.hpp
```c
#pragma once

#include <zephyr/drivers/gpio.h>

/**
 * @brief A simple button class that abstracts away the GPIO details
 * @details This class accepts a gpio_dt_spec in the contstructor
 */
class Button
{
public:
    Button(const struct gpio_dt_spec& button_spec) 
    : m_button(button_spec) 
    {
        if (gpio_is_ready_dt(&m_button)) 
        {
            auto ret = gpio_pin_configure_dt(&m_button, GPIO_INPUT);
            m_configured = (ret == 0);
        }
    }

    bool IsPressed() 
    {
        if(m_configured)
            return gpio_pin_get_dt(&m_button) > 0;
        return false;
    }

private:
    const struct gpio_dt_spec& m_button;
    bool m_configured{false};
};
```

## src/Led.hpp
```c
#pragma once

#include <zephyr/drivers/gpio.h>

/**
 * @brief A simple LED class that abstracts away the low level details
 * @details This class accepts a gpio_dt_spec in the contstructor
 */
class Led
{
public:
	Led(const struct gpio_dt_spec& led_spec) 
	: m_led(led_spec) 
	{
		if (gpio_is_ready_dt(&m_led)) 
		{
			auto ret = gpio_pin_configure_dt(&m_led, GPIO_OUTPUT_ACTIVE);
			m_configured = (ret == 0);
		}
	}

	void Toggle() 
	{
		if(m_configured)
			gpio_pin_toggle_dt(&m_led);
	}

	void TurnOn()
	{
		if(m_configured)
			gpio_pin_set_dt(&m_led, 1);
	}

	void TurnOff()
	{
		if(m_configured)
			gpio_pin_set_dt(&m_led, 0);
	}

private:
	const struct gpio_dt_spec& m_led;
	bool m_configured{false};
};
```

## src/Serial.cpp
```c
#include "Serial.hpp"

Serial::Serial(const struct uart_config& config, const struct device& uart_dev, 
               std::span<uint8_t> rxBuffer, UartCallBackFunc callback)
 : m_config(config), 
   m_uart_dev(uart_dev),
   m_rxBuffer(rxBuffer),
   m_callback(callback)
{  

}

int Serial::Initialize()
{
    if (!device_is_ready(&m_uart_dev)) 
	{
		return -1;
	}

	auto err = uart_configure(&m_uart_dev, &m_config);
	if (err == -ENOSYS) 
	{
		return -ENOSYS;
	}

    err = uart_callback_set(&m_uart_dev, m_callback, nullptr);
	if (err) 
	{
		return err;
	}

    m_initialized = true;
    EnableRx();
    
    return 0;
}

int Serial::Send(const char* data)
{
    if (!m_initialized) 
    {
        return -1;
    }

    return uart_tx(&m_uart_dev, reinterpret_cast<const uint8_t*>(data), strlen(data), 100);
}

int Serial::Receive()
{
    return 0;
}

void Serial::EnableRx()
{
    if(!m_initialized) 
    {
        return;
    }

    uart_rx_enable(&m_uart_dev, m_rxBuffer.data(), m_rxBuffer.size(), 100);    
}
```

## src/Serial.hpp
```c
#pragma once

#include <zephyr/drivers/uart.h>
#include <span>
class Serial
{
public:
    using UartCallBackFunc = void (*)(const struct device *dev, struct uart_event *evt, void *user_data);

    Serial(const struct uart_config& config, const struct device& uart_dev, 
           std::span<uint8_t> rxBuffer, UartCallBackFunc callback);

    int Initialize();
    int Send(const char* data);
    int Receive();
    void EnableRx();

private:

    const struct uart_config& m_config;
    const struct device& m_uart_dev;
    std::span<uint8_t> m_rxBuffer;
    UartCallBackFunc m_callback;

    bool m_initialized{false};
};
```
