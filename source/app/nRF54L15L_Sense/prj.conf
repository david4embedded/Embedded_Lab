## CMakeLists.txt
```
# SPDX-License-Identifier: Apache-2.0

cmake_minimum_required(VERSION 3.20.0)
find_package(Zephyr REQUIRED HINTS $ENV{ZEPHYR_BASE})
project(xiao_sense_hwcheck)

target_sources(app PRIVATE
    src/main.cpp
    src/AppShell.cpp
    src/Imu.cpp
    src/Mic.cpp
    )
```

## prj.conf
```kconfig
CONFIG_CPP=y
CONFIG_REQUIRES_FULL_LIBCPP=y
CONFIG_STD_CPP23=y

CONFIG_GPIO=y
CONFIG_I2C=y
CONFIG_HWINFO=y

# PDM microphone
CONFIG_AUDIO=y
CONFIG_AUDIO_DMIC=y

CONFIG_MAIN_STACK_SIZE=4096

# Shell on the console UART (uart20); imu/mic commands run on the shell thread
CONFIG_SHELL=y
CONFIG_SHELL_STACK_SIZE=4096

# Driver errors and fatal error (fault) dumps are printed through the shell log backend
CONFIG_LOG=y
```

## src/main.cpp
```c
/*
 * Hardware check application for Seeed Studio XIAO nRF54L15 Sense
 *
 * Checks the on-board LED, user button, 6-axis IMU and PDM microphone and prints
 * a PASS/FAIL summary at boot. Live readings are available through the shell
 * ("imu" and "mic" commands, see AppShell.hpp).
 *
 * SPDX-License-Identifier: Apache-2.0
 */

#include "AppShell.hpp"
#include "Button.hpp"
#include "Imu.hpp"
#include "Led.hpp"
#include "Mic.hpp"

#include <zephyr/drivers/gpio.h>
#include <zephyr/drivers/hwinfo.h>
#include <zephyr/drivers/i2c.h>
#include <zephyr/kernel.h>
#include <zephyr/sys/printk.h>

#define TICK_MS				(100)	// Main loop period
#define LED_TOGGLE_TICKS	(5)		// Heartbeat: toggle every 500 ms

// Device tree nodes
static const struct gpio_dt_spec s_gpioLed		= GPIO_DT_SPEC_GET(DT_ALIAS(led0), gpios);
static const struct gpio_dt_spec s_gpioButton	= GPIO_DT_SPEC_GET(DT_ALIAS(sw0), gpios);
static const struct i2c_dt_spec s_i2cImu		= I2C_DT_SPEC_GET(DT_ALIAS(imu0));
static const struct device *s_dmic				= DEVICE_DT_GET(DT_NODELABEL(dmic_dev));

// Shared with the shell commands, so they live for the whole run time
static Led s_led(s_gpioLed);
static Button s_button(s_gpioButton);
static Imu s_imu(s_i2cImu);
static Mic s_mic(*s_dmic);

static const char* ResultString(bool pass)
{
	return pass ? "PASS" : "FAIL";
}

static void PrintChipInfo()
{
	uint8_t id[16] = {0};
	auto len = hwinfo_get_device_id(id, sizeof(id));

	printk("Device ID   : ");
	if (len > 0)
	{
		for (ssize_t i = 0; i < len; ++i)
		{
			printk("%02X", id[i]);
		}
		printk("\n");
	}
	else
	{
		printk("n/a (%d)\n", static_cast<int>(len));
	}

	uint32_t cause = 0;
	if (hwinfo_get_reset_cause(&cause) == 0)
	{
		printk("Reset cause : 0x%08X\n", cause);
		hwinfo_clear_reset_cause();
	}
}

static bool CheckLed(Led& led)
{
	if (!led.IsConfigured())
	{
		return false;
	}

	// Blink 3 times so the LED can be checked visually
	for (int i = 0; i < 3; ++i)
	{
		led.TurnOn();
		k_msleep(150);
		led.TurnOff();
		k_msleep(150);
	}
	return true;
}

/**
 * @brief Capture one block to check that the mic delivers data
 */
static int CheckMic(Mic& mic, Mic::Level& level)
{
	auto ret = mic.Initialize();
	if (ret == 0)
	{
		ret = mic.Start();
	}
	if (ret == 0)
	{
		ret = mic.Read(level);
		mic.Stop();
	}
	return ret;
}

int main(void)
{
	printk("\n==============================================\n");
	printk(" XIAO nRF54L15 Sense - HW check (%s)\n", CONFIG_BOARD_TARGET);
	printk("==============================================\n");

	PrintChipInfo();

	const bool ledOk = CheckLed(s_led);
	const bool buttonOk = s_button.IsConfigured();

	const auto imuRet = s_imu.Initialize();
	const bool imuOk = (imuRet == 0);

	Mic::Level micLevel = {};
	const auto micRet = CheckMic(s_mic, micLevel);
	const bool micOk = (micRet == 0);

	printk("\n---------------- Self test -------------------\n");
	printk("[%s] LED    (P2.00)\n", ResultString(ledOk));
	printk("[%s] Button (P0.00)\n", ResultString(buttonOk));
	printk("[%s] IMU    WHO_AM_I=0x%02X (%s), ret=%d\n",
		ResultString(imuOk), s_imu.WhoAmI(), s_imu.ChipName(), imuRet);
	printk("[%s] Mic    PDM 16 kHz mono, ret=%d, peak=%d%s\n",
		ResultString(micOk), micRet, micLevel.peak, micLevel.flat ? " (FLAT)" : "");
	printk("----------------------------------------------\n");
	printk("Shell commands: imu info | imu read | imu stream <ms> | mic monitor [ms]\n");
	printk("Press ESC to stop streaming.\n\n");

	AppShell::Initialize(s_imu, imuOk, s_mic, micOk);

	for (uint32_t tick = 1; ; ++tick)
	{
		// LED stays on while the button is pressed, heartbeat otherwise
		if (s_button.IsPressed())
		{
			s_led.TurnOn();
		}
		else if ((tick % LED_TOGGLE_TICKS) == 0)
		{
			s_led.Toggle();
		}

		k_msleep(TICK_MS);
	}

	return 0;
}
```

## src/AppShell.cpp
```c
#include "AppShell.hpp"

#include <zephyr/kernel.h>
#include <zephyr/shell/shell.h>
#include <zephyr/sys/atomic.h>
#include <zephyr/sys/printk.h>

#include <algorithm>
#include <cmath>
#include <cstdlib>

namespace
{
constexpr uint32_t IMU_MIN_INTERVAL_MS	= 10;		// IMU ODR is 104 Hz
constexpr uint32_t IMU_MAX_INTERVAL_MS	= 60000;
constexpr uint32_t MIC_DEFAULT_INTERVAL_MS	= Mic::BLOCK_MS;
constexpr uint32_t MIC_MAX_INTERVAL_MS	= 10000;

// Level meter: one character per 2 dB from -90 dBFS to -20 dBFS
constexpr int32_t METER_MIN_DB10		= -900;		// 0.1 dB unit
constexpr int32_t METER_MAX_DB10		= -200;
constexpr int32_t METER_DB10_PER_CHAR	= 20;
constexpr int32_t METER_WIDTH			= (METER_MAX_DB10 - METER_MIN_DB10) / METER_DB10_PER_CHAR;
constexpr int32_t FULL_SCALE			= 32768;
constexpr int32_t CLIP_LEVEL			= 32000;

// Stream thread
constexpr size_t STREAM_STACK_SIZE		= 4096;
constexpr int STREAM_THREAD_PRIORITY	= 5;		// Lower than the shell thread (0)
constexpr int32_t STOP_TIMEOUT_MS		= 2000;		// Longest mic read (1000 ms) + margin

constexpr uint8_t KEY_ESC				= 0x1B;

enum class StreamType
{
	Imu,
	Mic,
};

struct StreamRequest
{
	const struct shell* sh;
	StreamType type;
	uint32_t interval;
};

Imu* s_imu = nullptr;
Mic* s_mic = nullptr;
bool s_imuReady = false;
bool s_micReady = false;

K_THREAD_STACK_DEFINE(s_streamStack, STREAM_STACK_SIZE);
struct k_thread s_streamThread;
bool s_streamThreadCreated = false;
StreamRequest s_request = {};

K_SEM_DEFINE(s_stopSem, 0, 1);		// Given by the bypass callback when ESC is received
K_SEM_DEFINE(s_doneSem, 0, 1);		// Given by the stream thread when it finishes
atomic_t s_stopRequested = ATOMIC_INIT(0);

/**
 * @brief Wait until the deadline or until ESC is pressed
 * @return true if ESC was pressed
 */
bool WaitForStop(int64_t deadline)
{
	const int64_t remaining = deadline - k_uptime_get();
	const k_timeout_t timeout = (remaining > 0) ? K_MSEC(remaining) : K_NO_WAIT;

	return k_sem_take(&s_stopSem, timeout) == 0;
}

bool IsStopRequested()
{
	return k_sem_take(&s_stopSem, K_NO_WAIT) == 0;
}

/**
 * @brief Check for a single ESC key press
 * @details Arrow and function keys also start with ESC (e.g. ESC [ A), so ESC followed
 *          by '[' or 'O' in the same chunk is treated as an escape sequence and ignored
 */
bool HasEscKey(const uint8_t* data, size_t len)
{
	for (size_t i = 0; i < len; ++i)
	{
		if (data[i] != KEY_ESC)
		{
			continue;
		}

		const bool isSequence = ((i + 1) < len) && ((data[i + 1] == '[') || (data[i + 1] == 'O'));
		if (!isSequence)
		{
			return true;
		}
	}
	return false;
}

/**
 * @brief Receives every input byte while a stream is running (shell thread context)
 */
void StreamBypass(const struct shell* sh, uint8_t* data, size_t len)
{
	if (!HasEscKey(data, len))
	{
		return;
	}

	atomic_set(&s_stopRequested, 1);
	k_sem_give(&s_stopSem);

	// Wait for the last output of the stream so that the prompt is printed after it
	(void)k_sem_take(&s_doneSem, K_MSEC(STOP_TIMEOUT_MS));
	shell_set_bypass(sh, NULL);
}

bool ParseInterval(const struct shell* sh, const char* arg, uint32_t min, uint32_t max, uint32_t& interval)
{
	int err = 0;
	auto value = shell_strtoul(arg, 10, &err);

	if ((err != 0) || (value < min) || (value > max))
	{
		shell_error(sh, "Invalid interval '%s' (%u ~ %u ms)", arg, min, max);
		return false;
	}

	interval = static_cast<uint32_t>(value);
	return true;
}

bool CheckImu(const struct shell* sh)
{
	if ((s_imu == nullptr) || !s_imuReady)
	{
		shell_error(sh, "IMU is not available");
		return false;
	}
	return true;
}

bool CheckMic(const struct shell* sh)
{
	if ((s_mic == nullptr) || !s_micReady)
	{
		shell_error(sh, "Mic is not available");
		return false;
	}
	return true;
}

void PrintImuHeader(const struct shell* sh)
{
	shell_print(sh, "  time[ms] |  ax[mg]  ay[mg]  az[mg] | gx[mdps] gy[mdps] gz[mdps] | temp[C]");
}

void PrintImuSample(const struct shell* sh, uint32_t timeMs, const Imu::Sample& sample)
{
	shell_print(sh, "%10u | %7d %7d %7d | %8d %8d %8d | %3d.%02d",
		timeMs,
		sample.accel_mg[0], sample.accel_mg[1], sample.accel_mg[2],
		sample.gyro_mdps[0], sample.gyro_mdps[1], sample.gyro_mdps[2],
		sample.temp_centi_c / 100, std::abs(sample.temp_centi_c % 100));
}

/**
 * @brief Convert an amplitude to dBFS in 0.1 dB unit (0 dBFS = full scale)
 */
int32_t ToDb10(int32_t amplitude)
{
	if (amplitude <= 0)
	{
		return METER_MIN_DB10;
	}

	const double db = 20.0 * std::log10(static_cast<double>(amplitude) / FULL_SCALE);
	return std::max(static_cast<int32_t>(std::lround(db * 10.0)), METER_MIN_DB10);
}

/**
 * @brief Stream IMU samples until ESC is pressed
 * @return true if stopped by ESC, false on error
 */
bool RunImuStream(const struct shell* sh, uint32_t interval)
{
	PrintImuHeader(sh);

	const int64_t start = k_uptime_get();
	int64_t next = start;
	uint32_t count = 0;

	for (;;)
	{
		Imu::Sample sample = {};
		auto ret = s_imu->Read(sample);
		if (ret != 0)
		{
			shell_error(sh, "IMU read failed (%d)", ret);
			return false;
		}

		PrintImuSample(sh, static_cast<uint32_t>(k_uptime_get() - start), sample);
		++count;

		// Skip missed slots instead of bursting when printing takes longer than the interval
		next += interval;
		const int64_t now = k_uptime_get();
		if (next < now)
		{
			next = now;
		}

		if (WaitForStop(next))
		{
			break;
		}
	}

	shell_print(sh, "Stopped by ESC (%u samples)", count);
	return true;
}

/**
 * @brief Print the mic level until ESC is pressed
 * @return true if stopped by ESC, false on error
 */
bool RunMicMonitor(const struct shell* sh, uint32_t interval)
{
	// The level is computed per 100 ms block
	const uint32_t blocksPerReport = interval / Mic::BLOCK_MS;

	auto ret = s_mic->Start();
	if (ret != 0)
	{
		shell_error(sh, "Mic start failed (%d)", ret);
		return false;
	}

	shell_print(sh, "Meter range: %d ~ %d dBFS, one '#' per %d dB", METER_MIN_DB10 / 10, METER_MAX_DB10 / 10, METER_DB10_PER_CHAR / 10);
	shell_print(sh, "  time[ms] |  peak |   rms | rms[dBFS] | level");

	const int64_t start = k_uptime_get();
	char meter[METER_WIDTH + 1] = {0};
	bool stopped = false;

	while (!stopped)
	{
		int32_t peak = 0;
		double sumSquare = 0.0;
		bool flat = true;

		for (uint32_t i = 0; i < blocksPerReport; ++i)
		{
			Mic::Level level = {};
			ret = s_mic->Read(level);
			if (ret != 0)
			{
				s_mic->Stop();
				shell_error(sh, "Mic read failed (%d)", ret);
				return false;
			}

			peak = std::max(peak, level.peak);
			sumSquare += static_cast<double>(level.rms) * level.rms;
			flat = flat && level.flat;

			if (IsStopRequested())
			{
				stopped = true;
				break;
			}
		}

		if (stopped)
		{
			break;
		}

		const auto rms = static_cast<int32_t>(std::sqrt(sumSquare / blocksPerReport));
		const int32_t db10 = ToDb10(rms);
		const int32_t bars = std::clamp((db10 - METER_MIN_DB10) / METER_DB10_PER_CHAR, int32_t{0}, METER_WIDTH);

		for (int32_t i = 0; i < METER_WIDTH; ++i)
		{
			meter[i] = (i < bars) ? '#' : '.';
		}

		// Format with one decimal place without float printf support; keep the sign for -0.x
		char dbText[16] = {0};
		snprintk(dbText, sizeof(dbText), "%s%d.%d", (db10 < 0) ? "-" : "", std::abs(db10) / 10, std::abs(db10) % 10);

		shell_print(sh, "%10u | %5d | %5d | %9s | %s%s%s",
			static_cast<uint32_t>(k_uptime_get() - start),
			peak, rms,
			dbText,
			meter,
			(peak >= CLIP_LEVEL) ? " CLIP" : "",
			flat ? " FLAT (no data?)" : "");
	}

	s_mic->Stop();
	shell_print(sh, "Stopped by ESC");
	return true;
}

void StreamThread(void* p1, void* p2, void* p3)
{
	ARG_UNUSED(p2);
	ARG_UNUSED(p3);

	const auto* request = static_cast<const StreamRequest*>(p1);

	if (request->type == StreamType::Imu)
	{
		(void)RunImuStream(request->sh, request->interval);
	}
	else
	{
		(void)RunMicMonitor(request->sh, request->interval);
	}

	k_sem_give(&s_doneSem);

	// Ended by an error: nobody waits in the bypass callback, so leave the bypass mode here.
	// The prompt shows up again with the next key input.
	if (!atomic_get(&s_stopRequested))
	{
		shell_print(request->sh, "Stream ended. Press Enter to continue.");
		shell_set_bypass(request->sh, NULL);
	}
}

/**
 * @brief Start the stream thread and pass every key input to StreamBypass()
 * @details The command returns right away. The shell thread has to keep running to
 *          receive ESC, so the stream itself runs on a separate thread.
 */
int StartStream(const struct shell* sh, StreamType type, uint32_t interval)
{
	if (s_streamThreadCreated)
	{
		// The previous stream has already signaled done; wait until its thread has exited
		(void)k_thread_join(&s_streamThread, K_FOREVER);
	}

	k_sem_reset(&s_stopSem);
	k_sem_reset(&s_doneSem);
	atomic_set(&s_stopRequested, 0);

	s_request.sh = sh;
	s_request.type = type;
	s_request.interval = interval;

	shell_set_bypass(sh, StreamBypass);

	k_thread_create(&s_streamThread, s_streamStack, K_THREAD_STACK_SIZEOF(s_streamStack),
		StreamThread, &s_request, NULL, NULL,
		STREAM_THREAD_PRIORITY, 0, K_NO_WAIT);
	k_thread_name_set(&s_streamThread, "stream");
	s_streamThreadCreated = true;

	return 0;
}

int CmdImuInfo(const struct shell* sh, size_t argc, char** argv)
{
	ARG_UNUSED(argc);
	ARG_UNUSED(argv);

	if (!CheckImu(sh))
	{
		return -ENODEV;
	}

	shell_print(sh, "WHO_AM_I=0x%02X (%s), ODR 104 Hz, accel +-2 g, gyro 250 dps", s_imu->WhoAmI(), s_imu->ChipName());
	return 0;
}

int CmdImuRead(const struct shell* sh, size_t argc, char** argv)
{
	ARG_UNUSED(argc);
	ARG_UNUSED(argv);

	if (!CheckImu(sh))
	{
		return -ENODEV;
	}

	Imu::Sample sample = {};
	auto ret = s_imu->Read(sample);
	if (ret != 0)
	{
		shell_error(sh, "IMU read failed (%d)", ret);
		return ret;
	}

	PrintImuHeader(sh);
	PrintImuSample(sh, k_uptime_get_32(), sample);
	return 0;
}

int CmdImuStream(const struct shell* sh, size_t argc, char** argv)
{
	ARG_UNUSED(argc);

	if (!CheckImu(sh))
	{
		return -ENODEV;
	}

	uint32_t interval = 0;
	if (!ParseInterval(sh, argv[1], IMU_MIN_INTERVAL_MS, IMU_MAX_INTERVAL_MS, interval))
	{
		return -EINVAL;
	}

	shell_print(sh, "Streaming IMU every %u ms. Press ESC to stop.", interval);
	return StartStream(sh, StreamType::Imu, interval);
}

int CmdMicMonitor(const struct shell* sh, size_t argc, char** argv)
{
	if (!CheckMic(sh))
	{
		return -ENODEV;
	}

	uint32_t interval = MIC_DEFAULT_INTERVAL_MS;
	if ((argc > 1) && !ParseInterval(sh, argv[1], Mic::BLOCK_MS, MIC_MAX_INTERVAL_MS, interval))
	{
		return -EINVAL;
	}

	// Round down to whole 100 ms blocks
	interval = (interval / Mic::BLOCK_MS) * Mic::BLOCK_MS;

	shell_print(sh, "Monitoring mic every %u ms. Press ESC to stop.", interval);
	return StartStream(sh, StreamType::Mic, interval);
}
}

SHELL_STATIC_SUBCMD_SET_CREATE(sub_imu,
	SHELL_CMD(info, NULL, "Show IMU chip information", CmdImuInfo),
	SHELL_CMD(read, NULL, "Read one accel/gyro/temperature sample", CmdImuRead),
	SHELL_CMD_ARG(stream, NULL,
		"Stream samples until ESC is pressed\n"
		"Usage: imu stream <interval_ms> (10 ~ 60000)",
		CmdImuStream, 2, 0),
	SHELL_SUBCMD_SET_END
);
SHELL_CMD_REGISTER(imu, &sub_imu, "IMU (LSM6DS3TR-C) commands", NULL);

SHELL_STATIC_SUBCMD_SET_CREATE(sub_mic,
	SHELL_CMD_ARG(monitor, NULL,
		"Print the sound level until ESC is pressed\n"
		"Usage: mic monitor [interval_ms] (100 ~ 10000, multiple of 100, default 100)",
		CmdMicMonitor, 1, 1),
	SHELL_SUBCMD_SET_END
);
SHELL_CMD_REGISTER(mic, &sub_mic, "PDM microphone commands", NULL);

namespace AppShell
{
	void Initialize(Imu& imu, bool imuReady, Mic& mic, bool micReady)
	{
		s_imu = &imu;
		s_imuReady = imuReady;
		s_mic = &mic;
		s_micReady = micReady;
	}
}
```

## src/AppShell.hpp
```c
#pragma once

#include "Imu.hpp"
#include "Mic.hpp"

/**
 * @brief Shell commands for the IMU and the microphone
 * @details Commands
 *          - imu info               : WHO_AM_I and chip name
 *          - imu read               : one accel/gyro/temperature sample
 *          - imu stream <ms>        : stream samples every <ms> until ESC is pressed
 *          - mic monitor [ms]       : print the sound level every [ms] until ESC is pressed
 *          Streaming runs on a separate thread while the shell is in bypass mode,
 *          so every key input goes to the stream and only ESC stops it.
 */
namespace AppShell
{
	/**
	 * @brief Register the objects used by the shell commands
	 * @details The commands report an error until this is called
	 */
	void Initialize(Imu& imu, bool imuReady, Mic& mic, bool micReady);
}
```

## src/Button.hpp
```c
#pragma once

#include <zephyr/drivers/gpio.h>

/**
 * @brief A simple button class that abstracts away the GPIO details
 * @details This class accepts a gpio_dt_spec in the constructor
 */
class Button
{
public:
	Button(const struct gpio_dt_spec& button_spec)
	: m_button(button_spec)
	{
		if (gpio_is_ready_dt(&m_button))
		{
			auto ret = gpio_pin_configure_dt(&m_button, GPIO_INPUT);
			m_configured = (ret == 0);
		}
	}

	bool IsConfigured() const
	{
		return m_configured;
	}

	bool IsPressed()
	{
		if(m_configured)
			return gpio_pin_get_dt(&m_button) > 0;
		return false;
	}

private:
	const struct gpio_dt_spec& m_button;
	bool m_configured{false};
};
```

## src/Imu.cpp
```c
#include "Imu.hpp"

#include <zephyr/kernel.h>

#include <cerrno>

namespace
{
	// Registers common to LSM6DS3TR-C and LSM6DSO
	constexpr uint8_t REG_WHO_AM_I	= 0x0F;
	constexpr uint8_t REG_CTRL1_XL	= 0x10;
	constexpr uint8_t REG_CTRL2_G	= 0x11;
	constexpr uint8_t REG_CTRL3_C	= 0x12;
	constexpr uint8_t REG_OUT_TEMP_L	= 0x20;	// TEMP(2) + GYRO(6) + ACCEL(6) follow in order

	constexpr uint8_t WHO_AM_I_LSM6DS3TRC	= 0x6A;
	constexpr uint8_t WHO_AM_I_LSM6DSO	= 0x6C;

	constexpr uint8_t ODR_104HZ_FS_DEFAULT	= 0x40;	// ODR = 104 Hz, accel +-2 g / gyro 250 dps
	constexpr uint8_t CTRL3_BDU_IF_INC	= 0x44;	// Block data update + register auto increment

	// Sensitivity at the full scale configured above
	constexpr int32_t ACCEL_UG_PER_LSB	= 61;	// 0.061 mg/LSB
	constexpr int32_t GYRO_CENTI_MDPS_PER_LSB	= 875;	// 8.75 mdps/LSB
	constexpr int32_t TEMP_LSB_PER_C	= 256;
	constexpr int32_t TEMP_OFFSET_CENTI_C	= 2500;	// 0 LSB = 25 degree Celsius

	int16_t ToInt16(const uint8_t* buf)
	{
		return static_cast<int16_t>(static_cast<uint16_t>(buf[0]) | (static_cast<uint16_t>(buf[1]) << 8));
	}
}

int Imu::Initialize()
{
	if (!i2c_is_ready_dt(&m_i2c))
	{
		return -ENODEV;
	}

	// The IMU power rail is enabled at boot; give the sensor time to finish its own boot sequence
	k_msleep(20);

	auto ret = i2c_reg_read_byte_dt(&m_i2c, REG_WHO_AM_I, &m_whoAmI);
	if (ret != 0)
	{
		return ret;
	}

	if ((m_whoAmI != WHO_AM_I_LSM6DS3TRC) && (m_whoAmI != WHO_AM_I_LSM6DSO))
	{
		return -ENOTSUP;
	}

	ret = i2c_reg_write_byte_dt(&m_i2c, REG_CTRL3_C, CTRL3_BDU_IF_INC);
	if (ret == 0)
	{
		ret = i2c_reg_write_byte_dt(&m_i2c, REG_CTRL1_XL, ODR_104HZ_FS_DEFAULT);
	}
	if (ret == 0)
	{
		ret = i2c_reg_write_byte_dt(&m_i2c, REG_CTRL2_G, ODR_104HZ_FS_DEFAULT);
	}

	return ret;
}

int Imu::Read(Sample& sample)
{
	uint8_t buf[14] = {0};

	auto ret = i2c_burst_read_dt(&m_i2c, REG_OUT_TEMP_L, buf, sizeof(buf));
	if (ret != 0)
	{
		return ret;
	}

	sample.temp_centi_c = TEMP_OFFSET_CENTI_C + (ToInt16(&buf[0]) * 100) / TEMP_LSB_PER_C;

	for (int axis = 0; axis < 3; ++axis)
	{
		sample.gyro_mdps[axis] = (ToInt16(&buf[2 + (axis * 2)]) * GYRO_CENTI_MDPS_PER_LSB) / 100;
		sample.accel_mg[axis] = (ToInt16(&buf[8 + (axis * 2)]) * ACCEL_UG_PER_LSB) / 1000;
	}

	return 0;
}

const char* Imu::ChipName() const
{
	switch (m_whoAmI)
	{
	case WHO_AM_I_LSM6DS3TRC:
		return "LSM6DS3TR-C";
	case WHO_AM_I_LSM6DSO:
		return "LSM6DSO";
	default:
		return "unknown";
	}
}
```

## src/Imu.hpp
```c
#pragma once

#include <zephyr/drivers/i2c.h>

#include <cstdint>

/**
 * @brief Minimal register-level driver for the on-board 6-axis IMU
 * @details The board DTS describes the IMU as "st,lsm6dso", but the XIAO nRF54L15 Sense
 *          carries an LSM6DS3TR-C (WHO_AM_I = 0x6A), which the Zephyr lsm6dso driver rejects.
 *          Both parts share the control/output register map used here, so the IMU is
 *          accessed over I2C directly instead of through the sensor driver.
 */
class Imu
{
public:
	struct Sample
	{
		int32_t accel_mg[3];		// milli-g
		int32_t gyro_mdps[3];		// milli-degree per second
		int32_t temp_centi_c;		// 0.01 degree Celsius
	};

	explicit Imu(const struct i2c_dt_spec& i2c_spec)
	: m_i2c(i2c_spec)
	{
	}

	/**
	 * @brief Check WHO_AM_I and configure accel (104 Hz, +-2 g) and gyro (104 Hz, 250 dps)
	 * @return 0 on success, negative errno otherwise
	 */
	int Initialize();

	/**
	 * @brief Read accel, gyro and temperature in one burst
	 * @return 0 on success, negative errno otherwise
	 */
	int Read(Sample& sample);

	uint8_t WhoAmI() const
	{
		return m_whoAmI;
	}

	const char* ChipName() const;

private:
	const struct i2c_dt_spec& m_i2c;
	uint8_t m_whoAmI{0};
};
```

## src/Led.hpp
```c
#pragma once

#include <zephyr/drivers/gpio.h>

/**
 * @brief A simple LED class that abstracts away the low level details
 * @details This class accepts a gpio_dt_spec in the constructor
 */
class Led
{
public:
	Led(const struct gpio_dt_spec& led_spec)
	: m_led(led_spec)
	{
		if (gpio_is_ready_dt(&m_led))
		{
			auto ret = gpio_pin_configure_dt(&m_led, GPIO_OUTPUT_INACTIVE);
			m_configured = (ret == 0);
		}
	}

	bool IsConfigured() const
	{
		return m_configured;
	}

	void Toggle()
	{
		if(m_configured)
			gpio_pin_toggle_dt(&m_led);
	}

	void TurnOn()
	{
		if(m_configured)
			gpio_pin_set_dt(&m_led, 1);
	}

	void TurnOff()
	{
		if(m_configured)
			gpio_pin_set_dt(&m_led, 0);
	}

private:
	const struct gpio_dt_spec& m_led;
	bool m_configured{false};
};
```

## src/Mic.cpp
```c
#include "Mic.hpp"

#include <zephyr/audio/dmic.h>
#include <zephyr/kernel.h>

#include <algorithm>
#include <cerrno>
#include <cmath>
#include <cstdlib>

namespace
{
	constexpr uint32_t SAMPLE_RATE		= 16000;
	constexpr uint8_t SAMPLE_BIT_WIDTH	= 16;
	constexpr uint32_t BLOCK_SIZE		= sizeof(int16_t) * (SAMPLE_RATE * Mic::BLOCK_MS / 1000);	// mono
	constexpr uint32_t BLOCK_COUNT		= 4;
	constexpr int32_t READ_TIMEOUT_MS	= 1000;
	constexpr int DISCARD_BLOCKS		= 2;	// Skip the start-up transient of the PDM filter
	constexpr int32_t STOP_WAIT_MS		= 20;	// Time for the driver to handle the STOPPED event

	// Change to PDM_CHAN_RIGHT if the level stays flat while talking near the mic
	constexpr enum pdm_lr MIC_CHANNEL	= PDM_CHAN_LEFT;
}

K_MEM_SLAB_DEFINE_STATIC(s_micSlab, BLOCK_SIZE, BLOCK_COUNT, 4);

int Mic::Initialize()
{
	if (!device_is_ready(&m_dmic))
	{
		return -ENODEV;
	}

	struct pcm_stream_cfg stream = {};
	stream.pcm_rate = SAMPLE_RATE;
	stream.pcm_width = SAMPLE_BIT_WIDTH;
	stream.block_size = BLOCK_SIZE;
	stream.mem_slab = &s_micSlab;

	struct dmic_cfg cfg = {};
	cfg.io.min_pdm_clk_freq = 1000000;
	cfg.io.max_pdm_clk_freq = 3500000;
	cfg.io.min_pdm_clk_dc = 40;
	cfg.io.max_pdm_clk_dc = 60;
	cfg.streams = &stream;
	cfg.channel.req_num_streams = 1;
	cfg.channel.req_num_chan = 1;
	cfg.channel.req_chan_map_lo = dmic_build_channel_map(0, 0, MIC_CHANNEL);

	auto ret = dmic_configure(&m_dmic, &cfg);
	m_configured = (ret == 0);
	return ret;
}

int Mic::Start()
{
	if (!m_configured)
	{
		return -EIO;
	}
	if (m_running)
	{
		return 0;
	}

	auto ret = dmic_trigger(&m_dmic, DMIC_TRIGGER_START);
	if (ret != 0)
	{
		return ret;
	}
	m_running = true;

	for (int i = 0; i < DISCARD_BLOCKS; ++i)
	{
		void* buffer = nullptr;
		size_t size = 0;

		ret = dmic_read(&m_dmic, 0, &buffer, &size, READ_TIMEOUT_MS);
		if (ret != 0)
		{
			Stop();
			return ret;
		}
		k_mem_slab_free(&s_micSlab, buffer);
	}

	return 0;
}

void Mic::Stop()
{
	if (!m_running)
	{
		return;
	}

	(void)dmic_trigger(&m_dmic, DMIC_TRIGGER_STOP);
	k_msleep(STOP_WAIT_MS);
	Drain();
	m_running = false;
}

void Mic::Drain()
{
	// Blocks completed before STOP stay in the driver queue; free them so the next Start() gets fresh audio
	void* buffer = nullptr;
	size_t size = 0;

	while (dmic_read(&m_dmic, 0, &buffer, &size, 0) == 0)
	{
		k_mem_slab_free(&s_micSlab, buffer);
	}
}

int Mic::Read(Level& level)
{
	if (!m_running)
	{
		return -EIO;
	}

	void* buffer = nullptr;
	size_t size = 0;

	auto ret = dmic_read(&m_dmic, 0, &buffer, &size, READ_TIMEOUT_MS);
	if (ret != 0)
	{
		return ret;
	}

	const auto* samples = static_cast<const int16_t*>(buffer);
	const size_t count = size / sizeof(int16_t);

	int64_t sum = 0;
	bool flat = true;
	for (size_t i = 0; i < count; ++i)
	{
		sum += samples[i];
		if (samples[i] != samples[0])
		{
			flat = false;
		}
	}

	const int32_t dc = (count > 0) ? static_cast<int32_t>(sum / static_cast<int64_t>(count)) : 0;

	int32_t peak = 0;
	double sumSquare = 0.0;
	for (size_t i = 0; i < count; ++i)
	{
		const int32_t ac = samples[i] - dc;
		peak = std::max(peak, std::abs(ac));
		sumSquare += static_cast<double>(ac) * ac;
	}

	k_mem_slab_free(&s_micSlab, buffer);

	level.peak = peak;
	level.rms = (count > 0) ? static_cast<int32_t>(std::sqrt(sumSquare / count)) : 0;
	level.dc = dc;
	level.flat = flat;

	return 0;
}
```

## src/Mic.hpp
```c
#pragma once

#include <zephyr/device.h>

#include <cstdint>

/**
 * @brief PDM microphone wrapper that reports the sound level of each captured block
 * @details Captures 16 kHz / 16 bit / mono PCM through the Zephyr DMIC API.
 *          One block holds 100 ms of audio, so Read() blocks for about 100 ms.
 *          Capturing runs only between Start() and Stop(); the driver stops by itself
 *          when blocks are not read, so keep calling Read() while started.
 */
class Mic
{
public:
	static constexpr uint32_t BLOCK_MS = 100;

	struct Level
	{
		int32_t peak;		// Peak absolute amplitude after DC removal (0 ~ 32767)
		int32_t rms;		// RMS amplitude after DC removal
		int32_t dc;			// DC offset of the block
		bool flat;			// true if every sample in the block has the same value
	};

	explicit Mic(const struct device& dmic)
	: m_dmic(dmic)
	{
	}

	/**
	 * @brief Configure the PDM peripheral (does not start capturing)
	 * @return 0 on success, negative errno otherwise
	 */
	int Initialize();

	/**
	 * @brief Start capturing and drop the start-up transient
	 * @return 0 on success, negative errno otherwise
	 */
	int Start();

	/**
	 * @brief Stop capturing and release the blocks left in the driver queue
	 */
	void Stop();

	/**
	 * @brief Wait for the next block and compute its level
	 * @return 0 on success, negative errno otherwise
	 */
	int Read(Level& level);

private:
	void Drain();

	const struct device& m_dmic;
	bool m_configured{false};
	bool m_running{false};
};
```
